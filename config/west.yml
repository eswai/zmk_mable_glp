## config/west.yml
```yaml
manifest:
  remotes:
    - name: zmkfirmware
      url-base: https://github.com/zmkfirmware
    - name: caksoylar  # zmk-rgbled-widget
      url-base: https://github.com/caksoylar
    - name: urob
      url-base: https://github.com/urob
    - name: eswai
      url-base: https://github.com/eswai
  projects:
    - name: zmk
      remote: zmkfirmware
      revision: main
      import: app/west.yml
    - name: zmk-rgbled-widget
      remote: caksoylar
      revision: main
    - name: zmk-helpers
      remote: urob
      revision: main
    - name: zmk-naginata
      remote: eswai
      revision: main
  self:
    path: config
```
